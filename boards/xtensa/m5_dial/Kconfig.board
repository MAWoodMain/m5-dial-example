## boards/xtensa/m5_dial/Kconfig.board
```kconfig
# Copyright (c) 2022 Espressif Systems (Shanghai) Co., Ltd.
# SPDX-License-Identifier: Apache-2.0

# M5 Dial board configuration
config BOARD_M5_DIAL
	bool "M5 Dial Board"
	depends on SOC_SERIES_ESP32S3

config BOARD_M5_DIAL_APPCPU
	bool "ESP32S3 Board configuration for APPCPU (core 1)."
	depends on SOC_SERIES_ESP32S3 && SOC_ESP32S3_APPCPU

choice SOC_PART_NUMBER
	default SOC_ESP32S3_MINI_N8
endchoice
```

## boards/xtensa/m5_dial/Kconfig.defconfig
```kconfig
# M5 Dial board configuration

# Copyright (c) 2022 Espressif Systems (Shanghai) Co., Ltd.
# SPDX-License-Identifier: Apache-2.0

if BOARD_M5_DIAL

config BOARD
	default "m5_dial"

config HEAP_MEM_POOL_ADD_SIZE_BOARD
	int
	default 98304 if WIFI
	default 40960 if BT
	default 4096

choice BT_HCI_BUS_TYPE
	default BT_ESP32 if BT
endchoice

endif

if BOARD_M5_DIAL_APPCPU

config BOARD
	default "m5_dial_appcpu"

config HEAP_MEM_POOL_ADD_SIZE_BOARD
	def_int 4096

config KERNEL_BIN_NAME
	default "esp32_net_firmware"
endif

config ENTROPY_GENERATOR
	default y
```

## tests/lib/custom_lib/testcase.yaml
```yaml
common:
  tags: extensibility
  integration_platforms:
    - m5_dial
tests:
  lib.custom_lib: {}
  lib.custom_lib.non_default:
    extra_args: CONFIG_CUSTOM_LIB_GET_VALUE_DEFAULT=6
```

## west.yml
```yaml
# Copyright (c) 2021 Nordic Semiconductor ASA
# SPDX-License-Identifier: Apache-2.0

manifest:
  self:
    west-commands: scripts/west-commands.yml

  remotes:
    - name: zephyrproject-rtos
      url-base: https://github.com/zephyrproject-rtos
    - name: amrithvenkat12
      url-base: https://github.com/amrithvenkat12

  projects:
    - name: zephyr
      remote: zephyrproject-rtos
      revision: main
      import:
        # By using name-allowlist we can clone only the modules that are
        # strictly needed by the application.
        name-allowlist:
          - cmsis      # required by the ARM port
          - hal_nordic # required by the custom_plank board (Nordic based)
          - hal_espressif  # required by the m5_dial board (ESP32-S3 based)
          - lvgl  # required by the m5_dial board, includes LCD
    - name: gc9a01a_zephyr_driver
      remote: amrithvenkat12
      revision: main
```
