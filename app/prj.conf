## sample.yaml
```
# This file is provided so that the application can be compiled using Twister,
# the Zephyr testing tool. In this file, multiple combinations can be specified,
# so that you can easily test all of them locally or in CI.
sample:
  description: M5 Dial Example Application
  name: m5-dial-example
common:
  build_only: true
  integration_platforms:
    - m5_dial
tests:
  app.default: {}
  app.debug:
    extra_overlay_confs:
      - debug.conf
```

## prj.conf
```kconfig
# Copyright (c) 2021 Nordic Semiconductor ASA
# SPDX-License-Identifier: Apache-2.0
#
# This file contains selected Kconfig options for the application.

CONFIG_SENSOR=y
CONFIG_DISPLAY=y
```

## boards/m5_dial.overlay
```dts
/*
 * Copyright (c) 2021 Nordic Semiconductor ASA
 * SPDX-License-Identifier: Apache-2.0
 */

/* This devicetree overlay file will be automatically picked by the Zephyr
 * build system when building the sample for the nucleo_f302r8 board. It shows
 * how the example-application can be built on sample boards already provided
 * by Zephyr.
 */

/ {
	examplesensor0: examplesensor_0 {
		compatible = "zephyr,examplesensor";
		input-gpios = <&gpio0 0 (GPIO_PULL_UP | GPIO_ACTIVE_LOW)>;
	};
};
```

## src/main.c
```c
/*
 * Copyright (c) 2021 Nordic Semiconductor ASA
 * SPDX-License-Identifier: Apache-2.0
 */

#include <zephyr/kernel.h>
#include <app_version.h>

#include <zephyr/logging/log.h>
#include <zephyr/drivers/display.h>

LOG_MODULE_REGISTER(main, CONFIG_APP_LOG_LEVEL);

int main(void)
{
    const struct device *display_dev;
    struct display_capabilities capabilities;
	printk("Zephyr Example Application %s\n", APP_VERSION_STRING);

    do {
        display_dev = DEVICE_DT_GET(DT_CHOSEN(zephyr_display));
        if (!device_is_ready(display_dev)) {
            LOG_ERR("Device %s not found. Aborting sample.",
                    display_dev->name);
            break;
        }

        LOG_INF("Display sample for %s", display_dev->name);
        display_get_capabilities(display_dev, &capabilities);
        LOG_INF("Display resolution %dx%d, orientation: %d", capabilities.x_resolution, capabilities.y_resolution,
                capabilities.current_orientation);

        while (1) {

            printk("Hello!\n");

            k_sleep(K_MSEC(1000));
        }
    } while(false);

	return 0;
}
```
